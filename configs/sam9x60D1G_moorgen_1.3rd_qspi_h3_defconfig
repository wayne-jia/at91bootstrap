## configs/sam9x60D1G_moorgen_1.3rd_qspi_h3_defconfig
```kconfig
CONFIG_SAM9X60=y
# CONFIG_SCLK is not set
CONFIG_DEBUG=y
# CONFIG_HW_DISPLAY_BANNER is not set
CONFIG_DDRC=y
CONFIG_DDR_SET_BY_DEVICE=y
CONFIG_DDR_W971GG6SB=y
CONFIG_SPI_CLK=100000000
CONFIG_QSPI_4B_OPCODES=y
CONFIG_QSPI_DTR_ENABLE=y
CONFIG_QSPI_DMA_SUPPORT=y
CONFIG_LOAD_1MB=y
CONFIG_IMG_ADDRESS="0x00050000"
CONFIG_JUMP_ADDR="0x23f00000"
CONFIG_THUMB=y
```

## configs/sam9x60_curiositynf_linux_image_dt_fastboot_initramfs_defconfig
```kconfig
CONFIG_SAM9X60=y
# CONFIG_SCLK is not set
# CONFIG_HW_DISPLAY_BANNER is not set
CONFIG_DDRC=y
CONFIG_DDR_SET_BY_DEVICE=y
CONFIG_DDR_W971GG6SB=y
CONFIG_NANDFLASH=y
# CONFIG_PMECC_AUTO_DETECT is not set
CONFIG_PMECC_PAGESIZE_4096=y
CONFIG_PMECC_OOB_256=y
CONFIG_PMECC_CORRECT_BITS_8=y
CONFIG_NAND_TIMING_MODE=y
CONFIG_SET_FEATURES_TIMING_MODE=y
CONFIG_ALL_TIMING_MODES=y
CONFIG_NAND_READ_SEQUENTIAL=y
# CONFIG_USE_ON_DIE_ECC_SUPPORT is not set
CONFIG_NAND_DMA_SUPPORT=y
CONFIG_LOAD_LINUX=y
CONFIG_OVERRIDE_CMDLINE=y
CONFIG_ARG_DELAY=""
CONFIG_ARG_MEMTEST=""
CONFIG_ARG_PRINTK=""
CONFIG_ARG_ROOT=""
CONFIG_ARG_ROOTFSTYPE=""
CONFIG_ARG_ROOTWAIT=""
CONFIG_ARG_RW=" quiet"
CONFIG_IMG_ADDRESS="0x00080000"
CONFIG_UNC_IMAGE=y
CONFIG_UNC_IMAGE_SIZE="0x900000"
CONFIG_OF_OFFSET="0x00040000"
CONFIG_XDMAC=y
CONFIG_LOGO=y
CONFIG_LOGO_ADDRESS="0x20000"
CONFIG_LOGO_SCALE="2"
```

## configs/sam9x60_curiositynf_linux_image_dt_fastboot_ubifs_defconfig
```kconfig
CONFIG_SAM9X60=y
# CONFIG_SCLK is not set
CONFIG_DEBUG=y
CONFIG_DDRC=y
CONFIG_DDR_SET_BY_DEVICE=y
CONFIG_DDR_W971GG6SB=y
CONFIG_NANDFLASH=y
# CONFIG_PMECC_AUTO_DETECT is not set
CONFIG_PMECC_PAGESIZE_4096=y
CONFIG_PMECC_OOB_256=y
CONFIG_PMECC_CORRECT_BITS_8=y
CONFIG_NAND_TIMING_MODE=y
CONFIG_SET_FEATURES_TIMING_MODE=y
CONFIG_ALL_TIMING_MODES=y
CONFIG_NAND_READ_SEQUENTIAL=y
# CONFIG_USE_ON_DIE_ECC_SUPPORT is not set
CONFIG_NAND_DMA_SUPPORT=y
CONFIG_LOAD_LINUX=y
CONFIG_OVERRIDE_CMDLINE=y
CONFIG_ARG_DELAY=""
CONFIG_ARG_MEMTEST=""
CONFIG_ARG_PRINTK=""
CONFIG_ARG_ROOTFSTYPE=" rootfstype=ubifs ubi.mtd=3 ubi.fm_autoconvert=1"
CONFIG_IMG_ADDRESS="0x00080000"
CONFIG_UNC_IMAGE=y
CONFIG_OF_OFFSET="0x00040000"
CONFIG_XDMAC=y
```

## configs/sam9x60ekdf_qspi_linux_image_dt_fastboot_defconfig
```kconfig
CONFIG_SAM9X60=y
# CONFIG_SCLK is not set
# CONFIG_HW_DISPLAY_BANNER is not set
CONFIG_DDRC=y
CONFIG_DDR_SET_BY_DEVICE=y
CONFIG_DDR_W972GG6KB_9X60=y
CONFIG_SPI_CLK=100000000
CONFIG_LOAD_LINUX=y
CONFIG_OVERRIDE_CMDLINE=y
CONFIG_ARG_DELAY=""
CONFIG_ARG_MEMTEST=""
CONFIG_ARG_PRINTK=""
CONFIG_ARG_ROOT=""
CONFIG_ARG_ROOTFSTYPE=""
CONFIG_ARG_ROOTWAIT=""
CONFIG_ARG_RW=""
CONFIG_UNC_IMAGE=y
CONFIG_UNC_IMAGE_SIZE="0x880000"
CONFIG_OF_OFFSET="0x00020000"
CONFIG_XDMAC=y
CONFIG_LOGO=y
CONFIG_LOGO_ADDRESS="0x10000"
CONFIG_LOGO_SCALE="3"
```

## configs/sam9x75_curiositysd_uboot_fastboot_defconfig
```kconfig
CONFIG_SAM9X7=y
# CONFIG_SCLK is not set
CONFIG_DEBUG=y
CONFIG_DDR_SET_BY_DEVICE=y
CONFIG_DDR_W632GU6NG=y
CONFIG_SDCARD=y
CONFIG_SDHC_ASYNC_READ=y
CONFIG_SDHC_ASYNC_READ_QUEUE_SIZE="256"
CONFIG_BOARD_QUIRK_SAM9X75_CURIOSITY=y
CONFIG_LED_ON_BOARD=y
CONFIG_LED_R_ON_PIOC=y
CONFIG_LED_R_PIN=19
CONFIG_LED_G_ON_PIOC=y
CONFIG_LED_G_PIN=21
CONFIG_LED_B_ON_PIOC=y
CONFIG_LED_B_PIN=20
```

## configs/sam9x75cusd_linux_image_dt_fastboot_defconfig
```kconfig
CONFIG_SAM9X7=y
# CONFIG_SCLK is not set
# CONFIG_HW_DISPLAY_BANNER is not set
CONFIG_DDR_SET_BY_DEVICE=y
CONFIG_DDR_W632GU6NG=y
CONFIG_SDCARD=y
CONFIG_SDHC_ASYNC_READ=y
CONFIG_SDHC_ASYNC_READ_QUEUE_SIZE="256"
CONFIG_LOAD_LINUX=y
CONFIG_OVERRIDE_CMDLINE=y
CONFIG_LINUX_KERNEL_ARG_STRING="CONFIG_ARG_CONSOLE CONFIG_ARG_MTD CONFIG_ARG_ROOT CONFIG_ARG_ROOTFSTYPE CONFIG_ARG_DELAY CONFIG_ARG_CMA CONFIG_ARG_RW CONFIG_ARG_ROOTWAIT CONFIG_ARG_PRINTK"
CONFIG_ARG_DELAY=""
CONFIG_ARG_MEMTEST=""
CONFIG_ARG_MTD=""
CONFIG_ARG_PRINTK=" lpj=1560576 quiet"
CONFIG_ARG_ROOTFSTYPE=" rootfstype=ext4"
CONFIG_UNC_IMAGE=y
CONFIG_OF_OVERRIDE_DTB_NAME="at91-sam9x75_curiosity.dtb"
CONFIG_LOGO=y
```

## configs/sam9x75ebnf_linux_image_dt_fastboot_defconfig
```kconfig
CONFIG_SAM9X7=y
# CONFIG_SCLK is not set
# CONFIG_HW_DISPLAY_BANNER is not set
CONFIG_DDR_SET_BY_DEVICE=y
CONFIG_DDR_MT41K128M16=y
CONFIG_NANDFLASH=y
CONFIG_NAND_TIMING_MODE=y
CONFIG_SET_FEATURES_TIMING_MODE=y
CONFIG_ALL_TIMING_MODES=y
CONFIG_NAND_READ_SEQUENTIAL=y
CONFIG_NAND_DMA_SUPPORT=y
CONFIG_LOAD_LINUX=y
CONFIG_OVERRIDE_CMDLINE=y
CONFIG_ARG_DELAY=""
CONFIG_ARG_MEMTEST=""
CONFIG_ARG_PRINTK=""
CONFIG_ARG_ROOT=""
CONFIG_ARG_ROOTFSTYPE=""
CONFIG_ARG_ROOTWAIT=""
CONFIG_ARG_RW=" quiet"
CONFIG_IMG_ADDRESS="0x00080000"
CONFIG_UNC_IMAGE=y
CONFIG_UNC_IMAGE_SIZE="0x900000"
CONFIG_OF_OFFSET="0x00040000"
CONFIG_XDMAC=y
```
